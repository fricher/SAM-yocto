## conf/distro/soy.conf
```bitbake
DISTRO_NAME = "SAM on Yocto"
DISTRO_VERSION = "0.6"

TCLIBC = "glibc"

DISTRO_FEATURES = "ipv4 opengl pulseaudio systemd ${DISTRO_FEATURES_LIBC}"
DISTRO_FEATURES_BACKFILL_CONSIDERED="bluez5 gobject-introspection-data sysvinit wifi"

PREFERRED_PROVIDER_virtual/kernel = "linux-raspberrypi-rt"
PREFERRED_VERSION_linux-raspberrypi-rt = "4.14%"

VIRTUAL-RUNTIME_init_manager = "systemd"
VIRTUAL-RUNTIME_initscripts = ""
VIRTUAL-RUNTIME_base-utils-syslog = ""

#VIRTUAL-RUNTIME_base-utils = "busybox"
#VIRTUAL-RUNTIME_base-utils-syslog = "busybox-syslog"
#VIRTUAL-RUNTIME_dev_manager = "udev"
#VIRTUAL-RUNTIME_login_manager = "busybox"
#VIRTUAL-RUNTIME_init_manager = "busybox"
#VIRTUAL-RUNTIME_keymaps = "keymaps"
#VIRTUAL-RUNTIME_initscripts = "initscripts"

SDK_VENDOR = "-soysdk"
SDK_VERSION = "${DISTRO_VERSION}"
SDK_NAME_PREFIX = "${DISTRO}"

include conf/machine/${MACHINE}-extra.conf
IMAGE_FSTYPES = "samsd"

INHERIT += "buildstats toaster buildhistory"
```

## conf/layer.conf
```bitbake
# We have a conf and classes directory, append to BBPATH
BBPATH .= ":${LAYERDIR}"

# We have a recipes directory, add to BBFILES
BBFILES += "${LAYERDIR}/recipes*/*/*.bb ${LAYERDIR}/recipes*/*/*.bbappend ${LAYERDIR}/images/*.bb"

BBFILE_COLLECTIONS += "sam"
BBFILE_PATTERN_sam := "^${LAYERDIR}/"
BBFILE_PRIORITY_sam = "16"

LAYERSERIES_COMPAT_sam = "thud warrior zeus"
```

## conf/machine/raspberrypi3-extra.conf
```bitbake
RPI_KERNEL_DEVICETREE = " \
    bcm2708-rpi-zero-w.dtb \
    bcm2708-rpi-b.dtb \
    bcm2708-rpi-b-plus.dtb \
    bcm2709-rpi-2-b.dtb \
    bcm2710-rpi-3-b.dtb \
    bcm2710-rpi-3-b-plus.dtb \
    bcm2708-rpi-cm.dtb \
    bcm2710-rpi-cm3.dtb \
    "

KERNEL_DEVICETREE = " \
    ${RPI_KERNEL_DEVICETREE} \
    ${RPI_KERNEL_DEVICETREE_OVERLAYS} \
    "

IMAGE_CLASSES += " samsd"
IMAGE_FSTYPES = "tar.bz2 ext3 rpi-sdimg samsd"
```
